## buildroot/Config.in
```kconfig
menu "ZPOD packages"
source "$BR2_EXTERNAL_ZPOD_PATH/package/zpod-dac/Config.in"
source "$BR2_EXTERNAL_ZPOD_PATH/package/zpod-overlays/Config.in"
source "$BR2_EXTERNAL_ZPOD_PATH/package/zpod-apps/Config.in"
source "$BR2_EXTERNAL_ZPOD_PATH/package/zpod-scripts/Config.in"
endmenu
```

## buildroot/package/zpod-apps/Config.in
```kconfig
config BR2_PACKAGE_ZPOD_APPS
	bool "zpod-apps (Rust launcher, boot splash, drop server, bundled apps)"
	help
	  Installs the M4 Rust userland cross-built by apps/tools/build-arm.sh
	  (target arm-unknown-linux-musleabihf, static, ARMv6):
	  /usr/lib/zpod/bin/{zpod-launcher,zpod-bootsplash,zpod-drop,zpod-app}
	  on the read-only rootfs, and the bundled .zpa packages (music,
	  clock, tetris) under /usr/share/zpod/packages; post-image.sh
	  pre-installs those into the data partition (/data/zpod/apps).
	  Run buildroot/build.sh (or apps/tools/build-arm.sh) first.

config BR2_PACKAGE_ZPOD_APPS_DIST
	string "path to apps/dist"
	default "$(BR2_EXTERNAL_ZPOD_PATH)/../apps/dist"
	depends on BR2_PACKAGE_ZPOD_APPS
```

## buildroot/package/zpod-dac/Config.in
```kconfig
config BR2_PACKAGE_ZPOD_DAC
	bool "zpod-dac (Aoide ZPOD PCM5122 ASoC machine driver)"
	depends on BR2_LINUX_KERNEL
	help
	  Out-of-tree ASoC machine driver aoide-zpod-dac.ko (compatible
	  "aoide,aoide-zpod-dac", card "sndrpiaoidezpod"): bcm2835 I2S +
	  in-tree pcm512x codec at I2C1 0x4d. PCM5122 GPIO4 drives the
	  headphone amp. Source: drivers/aoide-zpod-dac/ in this repo (the
	  same file the pi-gen image builds with DKMS).
```

## buildroot/package/zpod-overlays/Config.in
```kconfig
config BR2_PACKAGE_ZPOD_OVERLAYS
	bool "zpod-overlays (ZPOD device-tree overlays)"
	depends on BR2_PACKAGE_RPI_FIRMWARE
	help
	  Compiles drivers/aoide-zpod-dac/aoide-zpod-dac-overlay.dts into
	  rpi-firmware/overlays/aoide-zpod-dac.dtbo on the boot partition
	  (config.txt: dtoverlay=aoide-zpod-dac, as in the pi-gen image).
```

## buildroot/package/zpod-scripts/Config.in
```kconfig
config BR2_PACKAGE_ZPOD_SCRIPTS
	bool "zpod-scripts (buttons daemon, battery guard, USB gadget, audio init)"
	help
	  Installs the hardware helpers shared with the pi-gen image from
	  overlay/ in this repo (single source): zpod_buttons.py (uinput),
	  zpod_battery_guard.py, zpod_hw.py, zpod-usb-gadget.sh (CDC-NCM),
	  zpod-audio-init.sh, /etc/asound.conf and /etc/zpod/*.conf.
	  Python helpers need python3, python-evdev and python-smbus2.
```
